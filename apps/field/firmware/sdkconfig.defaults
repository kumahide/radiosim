## apps/tracer/firmware/sdkconfig.defaults
```kconfig
# RadioSim Tracer のファームの既定。`idf.py set-target esp32c6` の後に効く。

CONFIG_IDF_TARGET="esp32c6"

# 送信間隔（既定 100 ms）を ms 単位で刻むため。
CONFIG_FREERTOS_HZ=1000

# USB（USB Serial/JTAG）は測定データ専用にする。ログは UART0 のピンへ出す＝
# ログの 1 行がフレームの途中に割り込むと、そのフレームは CRC で弾かれ、
# PC 側では「電波で届かなかった」と区別の付かない欠けになる。
CONFIG_ESP_CONSOLE_UART_DEFAULT=y
CONFIG_ESP_CONSOLE_SECONDARY_NONE=y

# 起動直後の出力も減らす（ROM の起動表示は消せないが、PC 側は読み飛ばす）。
CONFIG_BOOTLOADER_LOG_LEVEL_WARN=y
CONFIG_LOG_DEFAULT_LEVEL_WARN=y
```
